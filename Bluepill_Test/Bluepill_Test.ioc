# file: Bluepill_Test.ioc
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Mcu.Family=STM32F1
Mcu.Name=STM32F103C(8-B)Tx
Mcu.Package=LQFP48
NVIC.PriorityGroup=NVIC_PRIORITYGROUP_4
PA13.Mode=Serial_Wire
PA13.Signal=SYS_JTMS-SWDIO
PA14.Mode=Serial_Wire
PA14.Signal=SYS_JTCK-SWCLK
PC13-TAMPER-RTC.PinState=GPIO_PIN_SET
PC13-TAMPER-RTC.Signal=GPIO_Output
ProjectManager.HeapSize=0x200
ProjectManager.StackSize=0x400
ProjectManager.TargetToolchain=CMake
RCC.APB1Freq_Value=8000000
RCC.APB2Freq_Value=8000000
board=custom

// file: Core/Src/main.c
/* USER CODE BEGIN Header */
/**
  ******************************************************************************
  * @file           : main.c
  * @brief          : Main program body
  ******************************************************************************
  * @attention
  *
  * Copyright (c) 2026 STMicroelectronics.
  * All rights reserved.
  *
  * This software is licensed under terms that can be found in the LICENSE file
  * in the root directory of this software component.
  * If no LICENSE file comes with this software, it is provided AS-IS.
  *
  ******************************************************************************
  */
/* USER CODE END Header */
#include "main.h"
#include "gpio.h"
#include "boot_protocol.h"
/* USER CODE BEGIN Includes */
#include "bootloader.h"
#include "boot_commands.h"
#include "boot_crc.h"
#include "boot_receiver.h"
/* USER CODE END Includes */

/* USER CODE BEGIN PV */
volatile uint32_t teste = 0;
volatile uint32_t boot_stay = 0;
volatile Boot_Info boot_info = {0};
volatile uint32_t debug_command = 0U;
volatile Boot_CommandStatus debug_status = BOOT_CMD_OK;
volatile uint32_t debug_crc = 0U;
volatile uint32_t debug_crc_empty = 0U;
uint8_t debug_frame[BOOT_PROTOCOL_MAX_FRAME_SIZE] = {0};
volatile uint32_t debug_frame_size = 0U;
Boot_FrameView debug_frame_view = {0};

volatile Boot_FrameStatus debug_parse_status;
volatile Boot_FrameStatus debug_corrupt_status;
volatile Boot_FrameStatus debug_short_status;
volatile Boot_FrameStatus debug_length_status;

uint8_t debug_response[BOOT_PROTOCOL_MAX_FRAME_SIZE] = {0};

volatile uint32_t debug_response_size = 0U;
volatile Boot_FrameStatus debug_response_status;

Boot_FrameView debug_response_view = {0};

Boot_Receiver debug_receiver;
Boot_FrameView debug_received_view = {0};

volatile Boot_RxResult debug_rx_result;
volatile uint32_t debug_ready_count = 0U;
volatile uint32_t debug_rejected_count = 0U;
volatile uint32_t debug_stream_ready = 0U;
volatile uint32_t debug_stream_rejected = 0U;
volatile Boot_FrameStatus debug_stream_error = BOOT_FRAME_OK;
/* USER CODE END PV */

void SystemClock_Config(void);

int main(void)
{

  /* MCU Configuration--------------------------------------------------------*/

  /* Reset of all peripherals, Initializes the Flash interface and the Systick. */
  HAL_Init();

  /* Configure the system clock */
  SystemClock_Config();

  /* Initialize all configured peripherals */
  MX_GPIO_Init();

/* USER CODE BEGIN 2 */
BootCommands_GetInfo(&boot_info);
app_vectors_ok = Bootloader_CheckApplicationVectors();
static const uint8_t crc_test_data[] = "123456789";

debug_crc = BootCRC_Calculate(
    crc_test_data,
    sizeof(crc_test_data) - 1U
);
debug_frame_size = (uint32_t)BootProtocol_BuildFrame(
    BOOT_CMD_GET_INFO,
    1U,
    NULL,
    0U,
    debug_frame,
    sizeof(debug_frame)
);
debug_parse_status = BootProtocol_ParseFrame(
    debug_frame,
    debug_frame_size,
    &debug_frame_view
);

/* Change one sequence bit without updating the CRC. */
debug_frame[4] ^= 0x01U;

Boot_FrameView corrupt_view = {0};

debug_corrupt_status = BootProtocol_ParseFrame(
    debug_frame,
    debug_frame_size,
    &corrupt_view
);

/* Restore the original frame. */
debug_frame[4] ^= 0x01U;
Boot_FrameView invalid_view = {0};

/* A frame shorter than the minimum must be rejected. */
debug_short_status = BootProtocol_ParseFrame(
    debug_frame,
    BOOT_PROTOCOL_MIN_FRAME_SIZE - 1U,
    &invalid_view
);

/* Declare 257 payload bytes, exceeding the 256-byte limit. */
debug_frame[6] = 0x01U;
debug_frame[7] = 0x01U;

debug_length_status = BootProtocol_ParseFrame(
    debug_frame,
    debug_frame_size,
    &invalid_view
);

/* Restore the original empty payload length. */
debug_frame[6] = 0U;
debug_frame[7] = 0U;

/* Refresh the validated request view. */
debug_parse_status = BootProtocol_ParseFrame(
    debug_frame,
    debug_frame_size,
    &debug_frame_view
);

if (debug_parse_status == BOOT_FRAME_OK)
{
    debug_response_size =
        (uint32_t)BootProtocol_BuildInfoResponse(
            &debug_frame_view,
            debug_response,
            sizeof(debug_response)
        );

    debug_response_status = BootProtocol_ParseFrame(
        debug_response,
        debug_response_size,
        &debug_response_view
    );
}
debug_crc_empty = BootCRC_Calculate(crc_test_data, 0U);

BootReceiver_Init(&debug_receiver);

debug_ready_count = 0U;
debug_rejected_count = 0U;

/* Noise before the packet must be ignored. */
BootReceiver_PushByte(
    &debug_receiver, 0x12U, &debug_received_view);

BootReceiver_PushByte(
    &debug_receiver, 0x34U, &debug_received_view);

/* Feed the valid GET_INFO frame one byte at a time. */
for (size_t i = 0U; i < debug_frame_size; i++)
{
    debug_rx_result = BootReceiver_PushByte(
        &debug_receiver,
        debug_frame[i],
        &debug_received_view
    );

    if (debug_rx_result == BOOT_RX_FRAME_READY)
    {
        debug_ready_count++;
    }
    else if (debug_rx_result == BOOT_RX_FRAME_REJECTED)
    {
        debug_rejected_count++;
    }
}

BootReceiver_Init(&debug_receiver);

debug_stream_ready = 0U;
debug_stream_rejected = 0U;
debug_stream_error = BOOT_FRAME_OK;

/* Send one corrupted frame followed by two valid frames. */
for (uint32_t packet = 0U; packet < 3U; packet++)
{
    for (size_t i = 0U; i < debug_frame_size; i++)
    {
        uint8_t byte = debug_frame[i];

        /* Corrupt one sequence byte in the first packet only. */
        if ((packet == 0U) && (i == 4U))
        {
            byte ^= 0x01U;
        }

        debug_rx_result = BootReceiver_PushByte(
            &debug_receiver,
            byte,
            &debug_received_view
        );

        if (debug_rx_result == BOOT_RX_FRAME_READY)
        {
            debug_stream_ready++;

            /* Process the view before receiving more bytes. */
        }
        else if (debug_rx_result == BOOT_RX_FRAME_REJECTED)
        {
            debug_stream_rejected++;
            debug_stream_error = debug_receiver.last_status;
        }
    }
}
if ((boot_stay == 0U) && (app_vectors_ok == 1U))
{
    Bootloader_TryStartApplication();
}

/* USER CODE END 2 */
  while (1)
  {

    /* USER CODE BEGIN 3 */
    if (debug_command != 0U)
{
    uint32_t command = debug_command;
    debug_command = 0U;

    debug_status = BootCommands_Execute(command, &boot_info);
}

teste++;
HAL_Delay(10);
  }
  /* USER CODE END 3 */
}

void SystemClock_Config(void)
{
  RCC_OscInitTypeDef RCC_OscInitStruct = {0};
  RCC_ClkInitTypeDef RCC_ClkInitStruct = {0};

  /** Initializes the RCC Oscillators according to the specified parameters
  * in the RCC_OscInitTypeDef structure.
  */
  RCC_OscInitStruct.OscillatorType = RCC_OSCILLATORTYPE_HSI;
  RCC_OscInitStruct.HSIState = RCC_HSI_ON;
  RCC_OscInitStruct.HSICalibrationValue = RCC_HSICALIBRATION_DEFAULT;
  RCC_OscInitStruct.PLL.PLLState = RCC_PLL_NONE;
  if (HAL_RCC_OscConfig(&RCC_OscInitStruct) != HAL_OK)
  {
    Error_Handler();
  }

  /** Initializes the CPU, AHB and APB buses clocks
  */
  RCC_ClkInitStruct.ClockType = RCC_CLOCKTYPE_HCLK|RCC_CLOCKTYPE_SYSCLK
                              |RCC_CLOCKTYPE_PCLK1|RCC_CLOCKTYPE_PCLK2;
  RCC_ClkInitStruct.SYSCLKSource = RCC_SYSCLKSOURCE_HSI;
  RCC_ClkInitStruct.AHBCLKDivider = RCC_SYSCLK_DIV1;
  RCC_ClkInitStruct.APB1CLKDivider = RCC_HCLK_DIV1;
  RCC_ClkInitStruct.APB2CLKDivider = RCC_HCLK_DIV1;

  if (HAL_RCC_ClockConfig(&RCC_ClkInitStruct, FLASH_LATENCY_0) != HAL_OK)
  {
    Error_Handler();
  }
}

void Error_Handler(void)
{
  __disable_irq();
  while (1)
  {
  }
}
